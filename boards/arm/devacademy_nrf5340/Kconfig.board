## boards/arm/devacademy_nrf5340/Kconfig.board
```kconfig
# Copyright (c) 2024 Nordic Semiconductor ASA
# SPDX-License-Identifier: Apache-2.0

if SOC_NRF5340_CPUAPP_QKAA

config BOARD_DEVACADEMY_NRF5340
	bool "DevAcademy nRF5340"

config BOARD_DEVACADEMY_NRF5340_NS
	bool "DevAcademy nRF5340 non-secure"

endif # SOC_NRF5340_CPUAPP_QKAA
```

## boards/arm/devacademy_nrf5340/Kconfig.defconfig
```kconfig
# Copyright (c) 2024 Nordic Semiconductor ASA
# SPDX-License-Identifier: Apache-2.0

if BOARD_DEVACADEMY_NRF5340 || BOARD_DEVACADEMY_NRF5340_NS

config BOARD
	default "devacademy_nrf5340"

config BUILD_WITH_TFM
	default y if BOARD_DEVACADEMY_NRF5340_NS

if BUILD_WITH_TFM

config TFM_FLASH_MERGED_BINARY
	bool
	default y

endif # BUILD_WITH_TFM

DT_CHOSEN_Z_CODE_PARTITION := zephyr,code-partition

config FLASH_LOAD_SIZE
	default $(dt_chosen_reg_size_hex,$(DT_CHOSEN_Z_CODE_PARTITION))
	depends on BOARD_DEVACADEMY_NRF5340 && TRUSTED_EXECUTION_SECURE

if BOARD_DEVACADEMY_NRF5340_NS

config FLASH_LOAD_OFFSET
	default $(dt_chosen_reg_addr_hex,$(DT_CHOSEN_Z_CODE_PARTITION))

config FLASH_LOAD_SIZE
	default $(dt_chosen_reg_size_hex,$(DT_CHOSEN_Z_CODE_PARTITION))

endif # BOARD_DEVACADEMY_NRF5340_NS

endif # BOARD_DEVACADEMY_NRF5340 || BOARD_DEVACADEMY_NRF5340_NS
```

## boards/arm/devacademy_nrf5340_ns/Kconfig
```kconfig
# DevAcademy nRF52833 board configuration

# Copyright (c) 2019 Nordic Semiconductor ASA
# SPDX-License-Identifier: Apache-2.0

config BOARD_ENABLE_DCDC
	bool "DCDC mode"
	select SOC_DCDC_NRF53X
	default y
	depends on BOARD_DEVACADEMY_NRF5340
```

## boards/arm/devacademy_nrf5340_ns/Kconfig.board
```kconfig
# Copyright (c) 2024 Nordic Semiconductor ASA
# SPDX-License-Identifier: Apache-2.0

config BOARD_DEVACADEMY_NRF5340_NS
	bool "DevAcademy NS nRF5340"
	depends on SOC_NRF5340_CPUAPP_QKAA
```

## boards/arm/devacademy_nrf5340_ns/Kconfig.defconfig
```kconfig
# Copyright (c) 2024 Nordic Semiconductor ASA
# SPDX-License-Identifier: Apache-2.0

if BOARD_DEVACADEMY_NRF5340_NS

config BOARD
	default "devacademy_nrf5340_ns"


#Build with TF-M as the Secure Execution Environment
config BUILD_WITH_TFM
	default y
endif
```

## boards/arm/devacademyns_nrf5340/Kconfig.defconfig
```kconfig
# Copyright (c) 2024 Nordic Semiconductor ASA
# SPDX-License-Identifier: Apache-2.0

if BOARD_DEVACADEMYNS_NRF5340

config BOARD
	default "devacademyns_nrf5340"


#Build with TF-M as the Secure Execution Environment
config BUILD_WITH_TFM
	default y
endif
```

## boards/arm/devacademyns_nrf5340/devacademyns_nrf5340_defconfig
```kconfig
# Copyright (c) 2024 Nordic Semiconductor ASA
# SPDX-License-Identifier: Apache-2.0

CONFIG_SOC_SERIES_NRF53X=y
CONFIG_SOC_NRF5340_CPUAPP_QKAA=y
CONFIG_BOARD_DEVACADEMYNS_NRF5340=y

# Enable MPU
CONFIG_ARM_MPU=y

# Enable hardware stack protection
CONFIG_HW_STACK_PROTECTION=y

# Enable TrustZone-M
CONFIG_ARM_TRUSTZONE_M=y

# This Board implies building Non-Secure firmware
CONFIG_TRUSTED_EXECUTION_NONSECURE=y

CONFIG_BOOTLOADER_MCUBOOT=y
CONFIG_FPROTECT=n
```
