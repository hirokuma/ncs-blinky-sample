// Copyright (c) 2024 Nordic Semiconductor ASA
// SPDX-License-Identifier: Apache-2.0

/dts-v1/;
#include <nordic/nrf5340_cpuappns_qkaa.dtsi>
#include "devacademy_nrf5340_common.dtsi"
#include "devacademy_nrf5340-pinctrl.dtsi"

/ {
	model = "DevAcademy nRF5340";
	compatible = "hirokuma,devacademy-nrf5340";

	chosen {
		zephyr,sram = &sram0_ns;
		zephyr,flash = &flash0;
		zephyr,code-partition = &slot0_ns_partition;
	};
};
