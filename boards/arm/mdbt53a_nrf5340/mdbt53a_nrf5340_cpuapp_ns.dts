/*
 * Copyright (c) 2021 Nordic Semiconductor ASA
 *
 * SPDX-License-Identifier: Apache-2.0
 */

/dts-v1/;
#include <nordic/nrf5340_cpuappns_qkaa.dtsi>
#include "mdbt53a_nrf5340_common.dtsi"

/ {
	model = "MDBT53A NRF5340 Application";
	compatible = "switchscience,mdbt53a-nrf5340-cpuapp";

	chosen {
		zephyr,sram = &sram0_ns;
		zephyr,flash = &flash0;
		zephyr,code-partition = &slot0_ns_partition;
	};

	aliases {
		watchdog0 = &wdt0;
	};
};
