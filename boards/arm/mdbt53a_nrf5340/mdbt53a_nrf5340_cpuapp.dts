/*
 * Copyright (c) 2021 Nordic Semiconductor ASA
 *
 * SPDX-License-Identifier: Apache-2.0
 */

/dts-v1/;
#include <nordic/nrf5340_cpuapp_qkaa.dtsi>
#include "mdbt53a_nrf5340_common.dtsi"

/ {
	model = "MDBT53A NRF5340 Application";
	compatible = "switchscience,mdbt53a-nrf5340-cpuapp";

	chosen {
		zephyr,sram = &sram0_image;
		zephyr,sram-secure-partition = &sram0_s;
		zephyr,sram-non-secure-partition = &sram0_ns;
	};

	aliases {
		watchdog0 = &wdt0;
	};
};
